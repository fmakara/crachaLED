/*
 * cracha_led.c
 *
 * Created: 27/08/2012 18:26:13
 *  Author: Felipe
 * Pinagem Colunas (normal baixo):
 *	PC2  PC0  PB4  PB2  PD3  PB6  PD5  PD7
 * Pinagem Verde (normal alto):
 *  PB0  PD6  PB7  PD4  PB1  PB3  PB5  PC1
 * Botão Modo: PC5
 * Porta Serial: PD0  PD1
 */ 
#define F_CPU 8000000
#include <avr/io.h>
#include <util/delay.h>
#include <avr/interrupt.h>
#include <avr/pgmspace.h>

char BUFFER[8];
char REFILL_BB;
char SEQUENCIA;
char NEXTB, NEXTC, NEXTD;
unsigned int TAMANHO, FRAME;
#define MAX_TAMANHO (5504/8) // = 688 frames = 55 segundos
//A mágica de todo o programa é que vai ter um bootloader arduino que vai carregar o programa inteiro a partir da serial.
//Este programa vai ser basicamente um cabeçalho com o executavel e todo o resto vai ser o video.
//O video é de 12.5 fps, 8x8 pixels de 1 bit cada um
//bit 0 mais ao "alto", bit 7 mais "abaixo", byte 0 mais "à esquerda", byte 7 mais "à direita"
//(com aspas pq dá pra girar o módulo...)
//então o utilitário vai converter o video em uma sequencia de bits, que vai embutir no .hex que vai mandar pro uC :) *magica piscando*



/*
atmega8.name=Arduino NG or older w/ ATmega8

atmega8.upload.protocol=stk500
atmega8.upload.maximum_size=7168
atmega8.upload.speed=19200

atmega8.bootloader.low_fuses=0xdf
atmega8.bootloader.high_fuses=0xca
atmega8.bootloader.path=atmega8
atmega8.bootloader.file=ATmegaBOOT.hex
atmega8.bootloader.unlock_bits=0x3F
atmega8.bootloader.lock_bits=0x0F

atmega8.build.mcu=atmega8
atmega8.build.f_cpu=8000000L
atmega8.build.core=arduino
*/
const unsigned char ANIMACAO[5506] PROGMEM = {
	32, 0,
	0, 1, 2, 3, 4, 5, 6, 7, 8, 9, 10, 11,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 99,
	0, 1, 2, 3, 4, 5, 6, 7, 8, 9, 10, 11,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 99,
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	0, 1, 2, 3
};
int main(void){
	int b;
	DDRB = 0b11111111;
	DDRC = 0b11011111;
	DDRD = 0b11111110;
	
	SEQUENCIA = 0;
	NEXTB = 0b10101011;
	NEXTC = 0b00000010;
	NEXTD = 0b01010000;//todos apagados
	
	PORTB = NEXTB;
	PORTC = NEXTC;
	PORTD = NEXTD;
	
	TCCR0B = 0b00000011;//SRC = CLK/64 //TCCR0 para atmega 8
	TCNT0 = 0;
	TIMSK0 = 0b00000001; // TIMSK para atmega 8
	sei();
	
	for(b=0;b<8;b++){
		BUFFER[b] = pgm_read_byte(&(ANIMACAO[(unsigned)b+2]));
	}
	TAMANHO = pgm_read_byte(&(ANIMACAO[0])) | (pgm_read_byte(&(ANIMACAO[1]))<<8) ;
	if(TAMANHO>MAX_TAMANHO)TAMANHO = MAX_TAMANHO;
	FRAME = 1;
	
	while(1){
		_delay_ms(1);
	}
}
ISR(TIMER0_OVF_vect){
	short a, b;
	PORTB = NEXTB;
	PORTC = NEXTC;
	PORTD = NEXTD;
	TCNT0 = 256-125;//clk/64/125/8 = 125 hz taxa atualização
	NEXTB = 0b10101011;
	NEXTC = 0b00000010;
	NEXTD = 0b01010000;//todos apagados
	b = SEQUENCIA%8;
	a = BUFFER[b];
	switch(b){//PB0  PD6  PB7  PD4  PB1  PB3  PB5  PC1
		case 0:NEXTC&=0b11111101;break;
		case 1:NEXTB&=0b11011111;break;
		case 2:NEXTB&=0b11110111;break;
		case 3:NEXTB&=0b11111101;break;
		case 4:NEXTD&=0b11101111;break;
		case 5:NEXTB&=0b01111111;break;
		case 6:NEXTD&=0b10111111;break;
		case 7:NEXTB&=0b11111110;break;
	}
	//PC2  PC0  PB4  PB2  PD3  PB6  PD5  PD7
	if(a&1  )NEXTD|=0b10000000;
	if(a&2  )NEXTD|=0b00100000;
	if(a&4  )NEXTB|=0b01000000;
	if(a&8  )NEXTD|=0b00001000;
	if(a&16 )NEXTB|=0b00000100;
	if(a&32 )NEXTB|=0b00010000;
	if(a&64 )NEXTC|=0b00000001;
	if(a&128)NEXTC|=0b00000100;
	SEQUENCIA++;
	if(SEQUENCIA==80){//videos de 12.5 fps
		SEQUENCIA = 0;
		FRAME++;
		if(FRAME==TAMANHO)FRAME = 0;
		for(b=0;b<8;b++){
			BUFFER[b] = pgm_read_byte(&(ANIMACAO[(unsigned)(b+2+8*FRAME)]));
		}
	}
	//if(SEQUENCIA==0)POSICAO++;
}